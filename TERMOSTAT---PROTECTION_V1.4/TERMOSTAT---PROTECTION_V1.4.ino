////////////////////////////////////////////////////////////////////////////////////////////////
//                                                                                            //
//                                ТЕРМОРЕГУЛЯТОР  (TERMOSTAT)                                 //
//            ЗАЩИТА ПОТРЕБИТЕЛЯ ПАУЗОЙ ПЕРЕД ПОДАЧЕЙ ПИТАНИЯ (DELAY PROTECTION)              //
//              Модуль поддержания постоянной температуры бытовым обогревателем               //
//               (Constant temperature control module for a household heater)                 //
//       Режим защиты выхода от серии кратковременных отключений электроснабжения часто       //
//     сопровождаемых опасными бросками напряжения настраиваемой паузой перед включением      //
//  Output protection mode against a series of short-term power outages often accompanied by  //
//               voltage surges with a configurable pause before switching ON                 //
//                                    Версия (Version) 1.4                                    //
//                   Код от Анатолия Невзорова (Сode by Anatoly Nevzoroff)                    //
//                            https://github.com/AnatolyNevzoroff                             //
//                                                                                            //
////////////////////////////////////////////////////////////////////////////////////////////////

////////////////////////////////////////////////////////////////////////////////////////////////
//  СОСТАВ ОБОРУДОВАНИЯ:
//  ARDUINO NANO (AVR ATmega328P либо LGT8F328P)
//  ДАТЧИК ТЕМПЕРАТУРЫ Dallas Semiconductor DS18B20 (-55°C...+125°C)
//  ЭКРАН 8 Digits Display (7-segment module on MAX7219)
//  ФОТОРЕЗИСТОР LDR (Light Dependent Resistor)
////////////////////////////////////////////////////////////////////////////////////////////////

////////////////////////////////////////////////////////////////////////////////////////////////
// НА ПЛАТЕ ARDUINO NANO (AVR ATmega328P либо LGT8F328P) ЗАДЕЙСТВОВАНЫ СЛЕДУЮЩИЕ ВЫВОДЫ:
//   D14      ADC GPIO  A0  <<-> LDR (Light Dependent Resistor) SENSOR (Photoresistor)
//   D15      ADC GPIO  A1  <<-> 
//   D16      ADC GPIO  A2  <<-> 
//   D17      ADC GPIO  A3  <<-> 
//   D18  SDA ADC GPIO  A4  <<-> 
//   D19  SCL ADC GPIO  A5  <<-> 
//   D20      ADC       A6  <<- 
//   D21      ADC       A7  <<-  
//       INT0     GPIO  D2  <-> 
// TMR2b INT1 PWM GPIO  D3  <->> 
//                GPIO  D4  <->  TEMPERATURE SENSOR DALLAS DS18B20
// TMR0b      PWM GPIO  D5  <->> LED INDICATOR "HEAT" (ORANGE LIGHT) and SOLID STATE RELAY
// TMR0a      PWM GPIO  D6  <->> BUTTON "POWER" (PRESS - LOW, NORMAL - HIGH)
//                GPIO  D7  <->  BUTTON "VOL -" (PRESS - LOW, NORMAL - HIGH)
//                GPIO  D8  <->  BUTTON "VOL +" (PRESS - LOW, NORMAL - HIGH)
// TMR1a      PWM GPIO  D9  <->> 
// TMR1b      PWM GPIO  D10 <->> CS  (8 DIGIT 7-SEGMENT LED DISPLAY MAX7219)
// TMR2a MOSO PWM GPIO  D11 <->> DIN (8 DIGIT 7-SEGMENT LED DISPLAY MAX7219)
//       MISO     GPIO  D12 <->  CLK (8 DIGIT 7-SEGMENT LED DISPLAY MAX7219)
//       SCLK     GPIO  D13 <->  LED INDICATOR "TERMOSTAT" (RED LIGHT)
/////////////////////////////////////////////////////////////////////////////////////////////////

//ПОДКЛЮЧАЕМЫЕ БИБЛИОТЕКИ:
//Если ссылка на библиотеку отсутствует, значит она входит в стандартный набор Аrduino IDE
//Для дополнительных библиотек указанны ссылки-первоисточники 
//С данным файлом выложены архивы библиотек в версиях на момент компиляции

#include <EEPROM.h> //ЧТЕНИЕ И ЗАПИСЬ ПЕРЕМЕННЫХ В ЭНЕРГОНЕЗАВИСИМУЮ ПАМЯТЬ EEPROM
//БИБЛИОТЕКА ДЛЯ ДРАЙВЕРОВ MAX7219 И MAX7221 СВЕТОДИОДНЫХ ИНДИКАТОРОВ И ПАНЕЛЕЙ
#include <LedControl.h> // https://github.com/wayoda/LedControl  
//БИБЛИОТЕКА ШИНЫ "OneWire" ДЛЯ ПОДКЛЮЧЕНИЯ ДО 255 ДАТЧИКОВ DS18B20 ПО ОДНОМУ ПРОВОДУ
#include <OneWire.h> // https://github.com/milesburton/Arduino-Temperature-Control-Library 


//В ПАМЯТИ МК МОГУТ НАХОДИТСЯ ПРОИЗВОЛЬНЫЕ ЗНАЧЕНИЯ, ПОЭТОМУ ТОЛЬКО ОДИН РАЗ!!!
//ПЕРЕД ПЕРВОЙ КОМПИЛЯЦИЕЙ ПРИСВАИВАЕМ ПЕРЕМЕННЫМ РЕКОМЕНДОВАННЫЕ ЗНАЧЕНИЯ
//ПЕРЕД ПОВТОРНОЙ КОМИПИЛЯЦИЕЙ И ЗАЛИВКОЙ КОМАНДУ КОММЕНТИРУЕМ ИЛИ УДАЛЯЕМ
// #define RECOMMENDED_VALUES


//ДЛЯ ОТЛАДКИ И ПРОВЕРКИ РАБОТЫ ОБОРУДОВАНИЯ НЕОБХОДИМО РАСКОММЕНТИРОВАТЬ 
// #define LOG_ENABLE //В РАБОЧЕЙ ВЕРСИИ УДАЛИТЬ ИЛИ ЗАКОММЕНТИРОВАТЬ! 

//ДЛЯ ПРОВЕРКИ ДАТЧИКА ТЕМПЕРАТУРЫ ВЫВОДИМ ЗНАЧЕНИЯ С DS18B20 В МОНИТОР СЕРИЙНОГО ПОРТА 
// #define LOG_ENABLE_TEMP

//ДЛЯ НАСТРОЙКИ ЯРКОСТИ ЭКРАНА ОТСЛЕЖИВАЕМ ОСВЕЩЁННОСТЬ В МОНИТОРЕ СЕРИЙНОГО ПОРТА 
// #define LOG_ENABLE_LDR 

//КОНТРОЛИРУЕМ ДАННЫЕ ОБРАБАЫВАЕМЫЕ ПИД В МОНИТОРЕ СЕРИЙНОГО ПОРТА 
// #define LOG_ENABLE_TEMP 



#define DS18B20_IN_PIN 4     //D4 ВХОД ДАТЧИКА ТЕМПЕРАТУРЫ DS18B20
#define HEAT_RELAY_OUT_PIN 5 //D5 ВЫХОД НА РЕЛЕ И ИНДИКАТОР ВКЛЮЧЕНИЯ НАГРУЗКИ (ОРАНЖЕВЫЙ)
#define POWER_KEY_IN_PIN 6   //D6 ВХОД КНОПКА "POWER" (ВКЛЮЧЕНИЕ И ИНДИКАТОР "TERMOSTAT")
#define STEP_DN_KEY_IN_PIN 7 //D7 ВХОД КНОПКА "VOL -" (ЗНАЧЕНИЕ УМЕНЬШИТЬ)
#define STEP_UP_KEY_IN_PIN 8 //D8 ВХОД КНОПКА "VOL +" (ЗНАЧЕНИЕ УВЕЛИЧИТЬ)
#define POWER_LED_OUT_PIN 13 //D13 ВЫХОД НА ИНДИКАТОР РЕЖИМА TERMOSTAT (КРАСНЫЙ)
#define LDR_SENSOR_IN_PIN 14 //A0 ВХОД ДЕЛИТЕЛЯ С ФОТОРЕЗИСТОРОМ 
#define Wait_AutoRet 9 //ДЛИТЕЛЬНОСТЬ ОЖИДАНИЯ АВТОВЫХОДА ИЗ МЕНЮ НАСТРОЙКИ ПАУЗЫ
#define WindowSize 10000 //ПЕРИОД 10 сек. ДЛЯ ВКЛ./ВЫКЛ. ВЫХОДА В ЗАВИСИМОСТИ ОТ ТЕМПЕРАТУРЫ


/////////////////////////////////////////////////////////////////////////////////////////////////
//                                     ГЛОБАЛЬНЫЕ ПЕРЕМЕННЫЕ                                   //
/////////////////////////////////////////////////////////////////////////////////////////////////
//unsigned long от 0 до 4294967295 (4 byte)
uint32_t Timer_BTN,Timer_MENU,Timer_REPEAT,Timer_TERMOSTAT;//СЛУЖЕБНЫЕ ТАЙМЕРЫ

//float от -3.4028235 E+38 до 3.4028235 E+38 (4 byte)
double Input;//ТЕКУЩАЯ ТЕМПЕРАТУРА

//int от -32768 до 32767 (2 byte)
int16_t SET_Temp,SET_TempMOD;//ЗАДАННАЯ ТЕМПЕРАТУРА
int16_t Fotorezist_OLD;//ВРЕМЕННО СОХРАНЯЕМОЕ ЗНАЧЕНИЕ НАПРЯЖЕНИЯ С ДЕЛИТЕЛЯ ФОТОРЕЗИСТОРА

//byte от 0 до 255 (1 byte)
uint8_t temp00,temp01,Secunds,Return;
uint8_t SET_Termostat,SET_TermostatMOD,SET_Pause,SET_PauseMOD,LED_Bright,LED_BrightMOD;
uint8_t ar1,ar2,ar3,ar4,ar5,ar6,ar7,ar8;//НОМЕРА РАЗРЯДОВ ИНДИКАТОРА
uint8_t LED_Intens_OLD=16,LED_Intens;

//char от -128 до 127 (1 byte)
int8_t Vol;

//boolean от false до true (1 byte)
bool FL_Start_Power=true;//ЕДИНСТВЕННЫЙ true ФЛАГ ДЛЯ НАЧАЛЬНОЙ ЗАГРУЗКИ 
bool POWER_btn,POWER_btn_status,SET_Protection,SET_ProtectionMOD,SET_DELAY_PROTECTION_menu;
bool STEP_DN_btn,STEP_DN_btn_status,STEP_UP_btn,STEP_UP_btn_status;
bool FL_Delay_POWER_key,FL_delay_MENU,FL_delay_REPEAT,FL_Delay_STEP_DN_key,FL_Delay_STEP_UP_key;
bool FL_STEP_UP_Batton_PRESS,FL_STEP_DN_Batton_PRESS,FL_STANDBY_menu,FL_PROTECTION_menu;
bool FL_Start_TERMOSTAT_menu;
/////////////////////////////////////////////////////////////////////////////////////////////////



//LedControl(dataPin,clockPin,csPin,numDevices) УКАЗЫВАЕМ ВЫВОДЫ ДЛЯ ПОДКЛЮЧЕНИЯ ЭКРАНА
LedControl LC=LedControl(11,12,10,1);//11-DIN, 12-CLC, 10-CS, 1-КОЛИЧЕСТВО ЭКРАНОВ
/////////////////////////////////////////////////////////////////////////////////////////////////

//ОБЪЯВЛЯЕМ ОБЪЕКТ "ds", ДЛЯ ЧТЕНИЯ ТЕМПЕРАТУРЫ С ДАТЧИКА DS18B20 ПОДКЛЮЧЕННОГО К D4
OneWire ds(DS18B20_IN_PIN);




/////////////////////////////////////////////////////////////////////////////////////////////////
//                                          S E T U P                                          //
/////////////////////////////////////////////////////////////////////////////////////////////////
void setup(){
#ifdef LOG_ENABLE
Serial.begin(9600);
#endif

//ИНИЦИАЛИЗАЦИЯ ВХОДОВ И ВЫХОДОВ
pinMode(LDR_SENSOR_IN_PIN,INPUT);//A0 ВХОД ДЕЛИТЕЛЯ С ФОТОРЕЗИСТОРОМ 
pinMode(POWER_KEY_IN_PIN,INPUT);//D6 ВХОД КНОПКА "POWER" (ВКЛЮЧЕНИЕ ИНДИКАТОРА "POWER")
pinMode(STEP_DN_KEY_IN_PIN,INPUT);//D7 ВХОД КНОПКА "VOL -" (ЗНАЧЕНИЕ УМЕНЬШИТЬ)
pinMode(STEP_UP_KEY_IN_PIN,INPUT);//D8 ВХОД КНОПКА "VOL +" (ЗНАЧЕНИЕ УВЕЛИЧИТЬ)
pinMode(HEAT_RELAY_OUT_PIN,OUTPUT);//D4 ВЫХОД НА РЕЛЕ И ИНДИКАТОР НАГРЕВА (ОРАНЖЕВЫЙ)
pinMode(POWER_LED_OUT_PIN,OUTPUT);//D13 ВЫХОД НА ИНДИКАТОР ВКЛЮЧЕНИЯ (КРАСНЫЙ)
//pinMode(11,OUTPUT);//ВЫХОД ДЛЯ ВЫВОДА "DIN" НА ИНДИКАТОРЕ С ДРАЙВЕРОМ MAX7219
//pinMode(12,OUTPUT);//ВЫХОД ДЛЯ ВЫВОДА "CLK" НА ИНДИКАТОРЕ С ДРАЙВЕРОМ MAX7219
//pinMode(10,OUTPUT);//ВЫХОД ДЛЯ ВЫВОДА "LOAD/CS" НА ИНДИКАТОРЕ С ДРАЙВЕРОМ MAX7219

//ОТКЛЮЧАЕМ ВЫХОДЫ УПРАВЛЯЮЩИЕ СИЛОВЫМ РЕЛЕ И ИНДИКАТОРАМИ ПРИ СТАРТЕ MK
digitalWrite(HEAT_RELAY_OUT_PIN,HIGH);//РЕЛЕ УПРАВЛЯЮЩЕЕ НАГРЕВОМ И ОРАНЖЕВЫЙ ИНДИКАТОР
digitalWrite(POWER_LED_OUT_PIN,HIGH);//КРАСНЫЙ ИНДИКАТОР ВКЛЮЧЕНИЯ




/////////////////////////////////////////////////////////////////////////////////////////////////
//                           СЧИТЫВАЕМ ЗНАЧЕНИЯ ПЕРЕМЕННЫХ ИЗ EEPROM                           //
/////////////////////////////////////////////////////////////////////////////////////////////////
//ПОСЛЕДНЯЯ ЗАДАННАЯ ТЕМПЕРАТУРА (ОТ 16 ДО 30 ГРАДУСОВ ЦЕЛЬСИЯ)
temp00=EEPROM.read(4);temp01=EEPROM.read(5);SET_Temp=word(temp00,temp01);//(160 ... 300)
SET_Termostat=EEPROM.read(1);//ПОСЛЕДНЕЕ СОСТОЯНИЕ ТЕРМОСТАТА "ON / OFF" (1,0)
SET_Pause=EEPROM.read(2);//ПАУЗА ПЕРЕД АВТОМАТИЧЕСКИМ ВКЛЮЧЕНИЕМ (0 ... 250) CEK.
SET_Protection=EEPROM.read(3);//СОСТОЯНИЕ РЕЖИМА ЗАЩИТЫ ЗАДЕРЖКОЙ "ON / OFF" (1,0)

#ifdef RECOMMENDED_VALUES
SET_Temp=240;
SET_Termostat=false;
SET_Pause=15;
SET_Protection=false;
#endif


//ПРИРАВНИВАЕМ ЗНАЧЕНИЯ ВРЕМЕННЫХ ПЕРЕМЕННЫХ ОСНОВНЫМ ДЛЯ СРАВНЕНИЯ ПЕРЕД ЗАПИСЬЮ
SET_TempMOD=SET_Temp;
SET_TermostatMOD=SET_Termostat;
SET_PauseMOD=SET_Pause;
SET_ProtectionMOD=SET_Protection;


//ПОДГОТАВЛИВАЕМ ДЛЯ РАБОТЫ МАХ7219
LC.shutdown(0,false);//ОТКЛЮЧАЕМ РЕЖИМ ЭНЕРГОСБЕРЕЖЕНИЯ 
LC.clearDisplay(0);//ОЧИЩАЕМ ОТ МУСОРА ПАМЯТЬ LED ЭКРАНА


}//END SETUP
/////////////////////////////////////////////////////////////////////////////////////////////////





/////////////////////////////////////////////////////////////////////////////////////////////////
//                                           L O O P                                           //
/////////////////////////////////////////////////////////////////////////////////////////////////

void loop(){

/////////////////////////////////////////////////////////////////////////////////////////////////
//                               КНОПКА ВКЛЮЧЕНИЯ "POWER ON/OFF"                               //
/////////////////////////////////////////////////////////////////////////////////////////////////

//АЛГОРИТМ ДЛЯ ОБРАБОТКИ КОМАНДЫ С "ХОРОШЕЙ" МЕМБРАННОЙ КНОПКИ (КАК НА ЭНКОДЕРЕ), ЧЕРЕЗ delay() 
//ЛОГИЧЕСКИЙ "0" (LOW) НАЖАТА / "1" (HIGH) ОТПУЩЕНА
/*
POWER_btn=digitalRead(POWER_KEY_IN_PIN); 
if(POWER_btn!=POWER_btn_status){delay(10);POWER_btn=digitalRead(POWER_KEY_IN_PIN); 
if(POWER_btn==LOW&&POWER_btn_status==HIGH){
if(SET_Protection==false){
SET_Termostat=!SET_Termostat;FL_Start_Power=true;}//"TERMOSTAT ON/OFF"
}
POWER_btn_status=POWER_btn;}
*/

//АЛГОРИТМ ДЛЯ ОБРАБОТКИ КОМАНДЫ С "ПЛОХОЙ" КНОПКИ
//ЕСЛИ КНОПКА НЕ ПРЕДНАЗНАЧЕНА ДЛЯ СЛАБОТОЧНЫХ ПЕРЕКЛЮЧЕНИЙ ИЛИ СТАРАЯ И СИЛЬНО ДРЕБЕЗЖИТ
//ЛОГИЧЕСКИЙ "0" (LOW) НАЖАТА / "1" (HIGH) НЕ НАЖАТА 
//ПОДРОБНЫЙ РАЗБОР АЛГОРИТМА РАБОТЫ КНОПКИ СМОТРИ НИЖЕ НА ПРИМЕРЕ КНОПКИ "+" (STEP_UP)

POWER_btn=digitalRead(POWER_KEY_IN_PIN);

if(POWER_btn!=POWER_btn_status){
POWER_btn_status=POWER_btn;
FL_Delay_POWER_key=true;
Timer_BTN=millis()+50;}

if(FL_Delay_POWER_key==true&&millis()>Timer_BTN){
if(POWER_btn==LOW){

if(SET_Protection==false){//ФАКТИЧЕСКИ БЛОКИРУЕМ ДЕЙСТВИЕ КНОПКИ ЕСЛИ ВКЛЮЧЕН РЕЖИМ ЗАЩИТЫ

SET_Termostat=!SET_Termostat;//ИЗМЕНЯЕМ ПЕРЕМЕННУЮ ПОСЛЕДНЕГО СОСТОЯНИЯ ТЕРМОСТАТА
FL_Start_Power=true;//ПОДНИМАЕМ ФЛАГ ДЛЯ УСТАНОВКИ НАЧАЛЬНЫХ ЗНАЧЕНИЙ

#ifdef LOG_ENABLE
Serial.println("НАЖАТА КНОПКА |POWER|");
#endif
}
}
   FL_Delay_POWER_key=false;}
/////////////////////////////////////////////////////////////////////////////////////////////////




/////////////////////////////////////////////////////////////////////////////////////////////////
//                          "+" КНОПКА УВЕЛИЧЕНИЯ ЗНАЧЕНИЯ "STEP_UP"                           //
/////////////////////////////////////////////////////////////////////////////////////////////////
//ПОДРОБНЫЙ РАЗБОР АЛГОРИТМА РАБОТЫ "ПЛОХОЙ" (СИЛЬНО ДРЕБЕЖАЩЕЙ) КНОПКИ НА millis()
STEP_UP_btn=digitalRead(STEP_UP_KEY_IN_PIN);//НЕПРЕРЫВНО ОПРАШИВАЕМ СОСТОЯНИЕ КНОПКИ (ВЫВОДА)
/////////////////////////////////////////////////////////////////////////////////////////////////

//БЛОК №1 ПЕРВИЧНОЕ ОБНАРУЖЕНИЕ НАЖАТИЯ
if(STEP_UP_btn!=STEP_UP_btn_status){//ЕСЛИ СОСТОЯНИЕ КНОПКИ "STEP_UP" ИЗМЕНИЛОСЬ
STEP_UP_btn_status=STEP_UP_btn;//ЗАПИСЫВАЕМ ВРЕМЕННОЕ СОСТОЯНИЕ КНОПКИ КАК ТЕКУЩЕЕ
FL_Delay_STEP_UP_key=true;//ПОДНИМАЕМ ФЛАГ ДЛЯ ДОПОЛНИТЕЛЬНОЙ ПРОВЕРКИ СОСТОЯНИЯ В БЛОКЕ №2
FL_delay_REPEAT=false;//ЗАПРЕЩАЕМ БЫСТЫЙ ПОВТОР БЕЗ ПРОХОЖДЕНИЯ БЛОКА ПРОВЕРКИ В БЛОКЕ №2
Timer_BTN=millis()+50;//УСТАНАВЛИВАЕМ ДЛИТЕЛЬНОСТЬ АНТИДРЕБЕЗГОВОЙ ЗАДЕРЖКИ (Например 50 мс)
//ДЛЯ НЕКАЧЕСТВЕННЫХ ИЛИ ИЗНОШЕННЫХ КНОПОК РЕКОМЕНДУЮ ЗНАЧЕНИЕ В ДИАПАЗОНЕ 50 - 100 мс 
//ЕСЛИ КНОПКА РАБОТАЕТ ХОРОШО ПРИ ЗНАЧЕНИЯХ 5-40 мс ИСПОЛЬЗУЙТЕ АЛГОРИТМ С delay()
//ЕСЛИ ТРЕБУЕТСЯ ЗАДЕРЖКА 100-200 ИЛИ БОЛЕЕ - ЗАМЕНИТЕ КНОПКУ
}//КОНЕЦ БЛОКА №1
/////////////////////////////////////////////////////////////////////////////////////////////////

//БЛОК №2 ЕСЛИ НАЖАТИЕ СОСТОЯЛОСЬ - ВЫПОЛНЯЕМ КОМАНДЫ АСОЦИИРОВАННЫЕ С КНОПКОЙ
//ЕСЛИ БЛОК №1 ПРОЙДЕН, И ПОДНЯТ ФЛАГ FL_Delay_STEP_UP_key
if(FL_Delay_STEP_UP_key==true&&millis()>Timer_BTN){//И ПРОШЛО ВРЕМЯ ЗАДЕРЖКИ
Timer_BTN=millis();//ОБНУЛЯЕМ ТАЙМЕР
if(STEP_UP_btn==LOW){//ЕСЛИ КНОПКА НАХОДИТСЯ В СОСТОЯНИИ "LOW" ("НАЖАТА")
//ЭТО СВИДЕТЕЛЬСТВУЕТ, ЧТО В ТЕЧЕНИЕ ВСЕГО ВРЕМЕНИ ЗАДЕРЖКИ БЛОК ПЕРВИЧНОЙ ПРОВЕРКИ ПЕРЕСТАЛ
//ВЫПОЛНЯТЬСЯ, ТЕМ САМЫМ НЕ ПРОДЛЕВАЯ ВРЕМЯ АНТИДРЕБЕЗГОВОЙ ЗАДЕРЖКИ, И ПРОВЕРКА ВЫПОЛНЕНА! 
//КНОПКА СВОЁ ОТДРЕБЕЗЖАЛА И УСТОЙЧИВО ЗАФИКСИРОВАНА В СОСТОЯНИИ "LOW"
FL_STEP_UP_Batton_PRESS=true;//ПОДНИМАЕМ ФЛАГ СИГНАЛИЗИРУЮЩИЙ ЧТО "КНОПКА "STEP_UP" НАЖАТА"

#ifdef LOG_ENABLE
Serial.println("НАЖАТА КНОПКА |STEP UP '+'|");
#endif

}//РАБОТА ОДНОКРАТНО НАЖАТОЙ КНОПКИ ЗАКОНЧЕНА
//ОПУСКАЕМ ФЛАГ ФИКСИРУЯ ВРЕМЕННОЕ СОСТОЯНИЕ КНОПКИ БЛОКИРУЯ ПОВТОРНОЕ СРАБАТЫВАНИЕ 
   FL_Delay_STEP_UP_key=false;
}//КОНЕЦ БЛОКА №2
/////////////////////////////////////////////////////////////////////////////////////////////////




/////////////////////////////////////////////////////////////////////////////////////////////////
//                          "-" КНОПКА УМЕНЬШЕНИЯ ЗНАЧЕНИЯ "STEP_DOUN"                         //
/////////////////////////////////////////////////////////////////////////////////////////////////
STEP_DN_btn=digitalRead(STEP_DN_KEY_IN_PIN);
//БЛОК №1
if(STEP_DN_btn!=STEP_DN_btn_status){
STEP_DN_btn_status=STEP_DN_btn;FL_Delay_STEP_DN_key=true;FL_delay_REPEAT=false;
Timer_BTN=millis()+50;}
//БЛОК №2
if(FL_Delay_STEP_DN_key==true&&millis()>Timer_BTN){
Timer_BTN=millis();
if(STEP_DN_btn==LOW){

FL_STEP_DN_Batton_PRESS=true;
#ifdef LOG_ENABLE
Serial.println("НАЖАТА КНОПКА |STEP DOUN '-'|");
#endif
}
   FL_Delay_STEP_DN_key=false;}
/////////////////////////////////////////////////////////////////////////////////////////////////





/////////////////////////////////////////////////////////////////////////////////////////////////
//                                         TERMOSTAT ON                                        //
/////////////////////////////////////////////////////////////////////////////////////////////////
if(SET_Termostat==true){

//БЛОК ОБРАБОТКИ КНОПОК ДЛЯ ИЗМЕНЕНИЯ ТРЕБУЕМОЙ ТЕМПЕРАТУРЫ
/////////////////////////////////////////////////////////////////////////////////////////////////
//ПРОДОЛЖАЕМ ПОДРОБНЫЙ РАЗБОР АЛГОРИТМА РАБОТЫ "ПЛОХОЙ" (СИЛЬНО ДРЕБЕЖАЩЕЙ) КНОПКИ
//БЛОК №3 ИСПОЛНИТЕЛЬНАЯ ЧАСТЬ КНОПКИ "+" (ЗДЕСЬ УКАЗЫВАЕМ ЧТО КОНКРЕТНО ДЕЛАТЬ ПРИ НАЖАТИИ)
if(FL_STEP_UP_Batton_PRESS==true){

//КОМАНДЫ СВЯЗАННЫЕ С НАЖАТИЕМ КНОПКИ:
++Vol;//УВЕЛИЧИВАЕМ ЗНАЧЕНИЕ ПЕРЕМЕННОЙ НА ЕДИНИЦУ
Show_Menu_TERMOSTAT();//ПЕРЕПЕЧАТЫВАЕМ МЕНЮ Т.К. ЗНАЧЕНИЕ ТЕМПЕРАТУРЫ ИЗМЕНИЛОСЬ

FL_delay_REPEAT=true;//ПОДНИМАЕМ ФЛАГ ДЛЯ АКТИВАЦИИ РЕЖИМА БЫСТРОГО ПОВТОРА КОМАНДЫ
Timer_REPEAT=millis();Timer_MENU=millis();Timer_TERMOSTAT=millis();//ОБНУЛЯЕМ ТАЙМЕРЫ 
   FL_STEP_UP_Batton_PRESS=false;}//КОНЕЦ БЛОКА №3
/////////////////////////////////////////////////////////////////////////////////////////////////



/////////////////////////////////////////////////////////////////////////////////////////////////
//БЛОК №4 КНОПКИ "+" ДОПОЛНИТЕЛЬНЫЙ БЛОК ДЛЯ БЫСТРОГО АВТОМАТИЧЕСКОГО ПОВТОРА КОМАНД
//ЕСЛИ КНОПКА БЫЛА НАЖАТА, И СТАБИЛЬНО УДЕРЖИВАЕТСЯ ПОЛЬЗОВАТЕЛЕМ БОЛЕЕ 0,5 сек.
if(FL_delay_REPEAT==true&&STEP_UP_btn==LOW&&millis()-Timer_BTN>500){
 
if(millis()>Timer_REPEAT){Timer_REPEAT=millis()+110;//КАЖДЫЕ 0,11сек. 

//АВТОМАТИЧЕСКИ ВЫПОЛНЯЕМ КОМАНДЫ СВЯЗАННЫЕ С НАЖАТИЕМ КНОПКИ (КАК В БЛОКЕ №3)
++Vol;//УВЕЛИЧИВАЕМ ЗНАЧЕНИЕ ПЕРЕМЕННОЙ НА ЕДИНИЦУ
Show_Menu_TERMOSTAT();//ПЕРЕПЕЧАТЫВАЕМ МЕНЮ Т.К. ЗНАЧЕНИЕ ТЕМПЕРАТУРЫ ИЗМЕНИЛОСЬ

Timer_MENU=millis();}//ОБНУЛЯЕМ ТАЙМЕР АВТОМАТИЧЕСКОГО ПОКАЗА ТЕМПЕРАТУРЫ

#ifdef LOG_ENABLE
Serial.println("НАЖАТА КНОПКА |FAST '+'|");
#endif
}//КОНЕЦ БЛОКА №4
/////////////////////////////////////////////////////////////////////////////////////////////////



/////////////////////////////////////////////////////////////////////////////////////////////////
//ИСПОЛНИТЕЛЬНАЯ ЧАСТЬ КНОПКИ "-"
//БЛОК №3
if(FL_STEP_DN_Batton_PRESS==true){
--Vol;Show_Menu_TERMOSTAT();FL_delay_REPEAT=true;
Timer_REPEAT=millis();Timer_MENU=millis();Timer_TERMOSTAT=millis();
   FL_STEP_DN_Batton_PRESS=false;}
//БЛОК №4
if(FL_delay_REPEAT==true&&STEP_DN_btn==LOW&&millis()-Timer_BTN>500){
if(millis()>Timer_REPEAT){Timer_REPEAT=millis()+110;--Vol;Show_Menu_TERMOSTAT();Timer_MENU=millis();}
}
/////////////////////////////////////////////////////////////////////////////////////////////////
//КОНЕЦ БЛОКА ОБРАБОТКИ КНОПОК




/////////////////////////////////////////////////////////////////////////////////////////////////
//ЗАДАЁМ НАЧАЛЬНЫЕ ЗНАЧЕНИЯ ДЛЯ РЕЖИМА "TERMOSTAT ON"
if(FL_Start_TERMOSTAT_menu==true){
LC.clearDisplay(0);//ЧИСТИМ ПАМЯТЬ У ИНДИКАТОРА
FL_STANDBY_menu=false;//ЗАПРЕЩАЕМ ПОКАЗ МЕНЮ ПРОСТОЯ
digitalWrite(POWER_LED_OUT_PIN,LOW);//ВКЛЮЧАЕМ LED ИНДИКАТОР "TERMOSTAT"
EEPROM_UPDATE();//СОХРАНЯЕМ ПЕРЕМЕННЫЕ В ПАМЯТЬ
Timer_TERMOSTAT=millis()-WindowSize;Timer_MENU=millis()-3000;//ЗАНИЖАЕМ ТАЙМЕРЫ
   FL_Start_TERMOSTAT_menu=false;}
/////////////////////////////////////////////////////////////////////////////////////////////////



/////////////////////////////////////////////////////////////////////////////////////////////////
//ВЫВОДИМ ТЕКУЩУЮ И ЗАДАННУЮ ТЕМПЕРАТУРЫ НА ИНДИКАТОР КАЖДЫЕ 3 СЕКУНДЫ
if(millis()-Timer_MENU>3000){
Timer_MENU=millis();
TEMPERATURA();
Show_Menu_TERMOSTAT();
LED_Brightness();
}
/////////////////////////////////////////////////////////////////////////////////////////////////



/////////////////////////////////////////////////////////////////////////////////////////////////
if(millis()-Timer_TERMOSTAT>WindowSize){//Если прошло время равное WindowSize
Timer_TERMOSTAT=millis();

if(Timer_TERMOSTAT>millis()){Timer_TERMOSTAT=0;}//Защита от переполнения millis()
int Temperature=(Input*10);//Переводим температуру в целое число
if(Temperature<SET_Temp){//Если фактическая температура меньше заданной
digitalWrite(HEAT_RELAY_OUT_PIN,LOW);//Включаем твердотельное реле
  }else{//Если нет
digitalWrite(HEAT_RELAY_OUT_PIN,HIGH);//Выключаем твердотельное реле
  }

#ifdef LOG_ENABLE_TEMP
Serial.print(F("Температура ПРЕОБРАЗОВАННАЯ  (Temperature): "));Serial.println(Temperature);
Serial.print(F("Температура ЗАДАННАЯ  (SET_Temp): "));Serial.println(SET_Temp);
Serial.println();
#endif

  }//КОНЕЦ БЛОКА УПРАВЛЕНИЯ РЕЛЕ
/////////////////////////////////////////////////////////////////////////////////////////////////

}//END TERMOSTAT MENU
/////////////////////////////////////////////////////////////////////////////////////////////////






/////////////////////////////////////////////////////////////////////////////////////////////////
//                                          TERMOSTAT OFF                                      //
/////////////////////////////////////////////////////////////////////////////////////////////////
if(SET_Termostat==false){

//БЛОК ОБРАБОТКИ КНОПОК "-" ИЛИ "+"  
/////////////////////////////////////////////////////////////////////////////////////////////////
//НАЖИМАЯ И УДЕРЖИВАЯ КНОПОКУ "-" ВКЛЮЧАЕМ МЕНЮ УСТАНОВКИ ВРЕМЕНИ ЗАДЕРЖКИ ПЕРЕД ВКЛЮЧЕНИЕМ

//ЕСЛИ КНОПКА ПРОШЛА ПРОВЕРКУ, ОСТАЁТСЯ СТАБИЛЬНО НАЖАТА (УДЕРЖИВАЕТСЯ) НЕ МЕНЕЕ 2 сек.
if(FL_STEP_DN_Batton_PRESS==true&&STEP_DN_btn==LOW&&millis()>Timer_BTN+2000){
SET_DELAY_PROTECTION_menu=true;//ПЕРЕХОДИМ В МЕНЮ УСТАНОВКИ ПАУЗЫ ПЕРЕД ВКЛЮЧЕНИЕМ
LC.clearDisplay(0);//ЧИСТИМ ПАМЯТЬ У ИНДИКАТОРА
Return=Wait_AutoRet;
#ifdef LOG_ENABLE
Serial.println("НАЖАТА КНОПКА |MENU DELAY PROTECTION|");
#endif
   FL_STEP_DN_Batton_PRESS=false;}
/////////////////////////////////////////////////////////////////////////////////////////////////



/////////////////////////////////////////////////////////////////////////////////////////////////
//НАЖИМАЯ И УДЕРЖИВАЯ КНОПОКУ "+" ВКЛЮЧАЕМ / ОТКЛЮЧАЕМ РЕЖИМ ЗАЩИТЫ ПАУЗОЙ ПЕРЕД ПОДАЧЕЙ ПИТАНИЯ

//ЕСЛИ КНОПКА ПРОШЛА ПРОВЕРКУ, ОСТАЁТСЯ СТАБИЛЬНО НАЖАТА (УДЕРЖИВАЕТСЯ) НЕ МЕНЕЕ 2 сек.
if(FL_STEP_UP_Batton_PRESS==true&&STEP_UP_btn==LOW&&millis()>Timer_BTN+2000){
SET_Protection=!SET_Protection;
if(SET_Protection==false){FL_Start_Power=true;}else{digitalWrite(HEAT_RELAY_OUT_PIN,LOW);}
EEPROM_UPDATE();//СОХРАНЯЕМ ПЕРЕМЕННЫЕ В ПАМЯТЬ
#ifdef LOG_ENABLE
Serial.println("НАЖАТА КНОПКА |ON/OFF PROTECTION|");
#endif
   FL_STEP_UP_Batton_PRESS=false;}

}//КОНЕЦ БЛОКА КНОПОК ПРИ ВЫКЛЮЧЕННОМ ТЕРМОСТАТЕ
/////////////////////////////////////////////////////////////////////////////////////////////////




//ЗАДАЁМ ПАРАМЕТРЫ ДЛЯ РЕЖИМА "STANDBY" (ТЕРМОСТАТ И ЗАЩИТА ВЫКЛЮЧЕНЫ)
//ЭТО САМЫЙ ПЕРВЫЙ БЛОК ИСПОЛНЯЕМЫЙ ПОСЛЕ ВКЛЮЧЕНИЯ
if(FL_Start_Power==true){
LC.clearDisplay(0);//ЧИСТИМ ЭКРАН
EEPROM_UPDATE();//СОХРАНЯЕМ ПЕРЕМЕННЫЕ В ПАМЯТЬ
Timer_MENU=millis()-3000;//ДЛЯ МГНОВЕННОГО ПОКАЗА ТЕМПЕРАТУРЫ
digitalWrite(POWER_LED_OUT_PIN,HIGH);//ОТКЛЮЧАЕМ ИНДИКАТОР "POWER"
digitalWrite(HEAT_RELAY_OUT_PIN,HIGH);//ОТКЛЮЧАЕМ РЕЛЕ И ИНДИКАТОР "HEAT"
Secunds=SET_Pause+1;//ЗАДАЁМ ВРЕМЕННОЙ ПЕРЕМЕННОЙ ЗНАЧЕНИЕ ЧИСЛА СЕКУНД ДО ВКЛЮЧЕНИЯ 

//ЕСЛИ ДО ВЕКЗАПНОГО ОТКЮЧЕНИЯ ПИТАНИЯ:
//РЕЖИМ ЗАЩИТЫ БЫЛ ВКЛЮЧЕН -> ЗАПУСКАЕМ МЕНЮ ЗАДЕРЖКИ ВКЛЮЧЕНИЯ
if(SET_Protection==true){FL_PROTECTION_menu=true;FL_STANDBY_menu=false;}

//РЕЖИМ ТЕРМОСТАТА БЫЛ ВЫКЛЮЧЕН -> ЗАПУСКАЕМ МЕНЮ ОТОБРАЖЕНИЯ ТЕКУЩЕЙ ТЕМПЕРАТУРЫ
if(SET_Termostat==false){FL_STANDBY_menu=true;}

//РЕЖИМ ТЕРМОСТАТА БЫЛ ВКЛЮЧЕН -> ЗАПУСКАЕМ ТЕРМОСТАТ
if(SET_Termostat==true){FL_Start_TERMOSTAT_menu=true;}
   FL_Start_Power=false;}



/////////////////////////////////////////////////////////////////////////////////////////////////
//                                        МЕНЮ ВЫВОДА ТЕМПЕРАТУРЫ                              //
//                                                STANDBY                                      //
/////////////////////////////////////////////////////////////////////////////////////////////////
if(FL_STANDBY_menu==true){
if(millis()-Timer_MENU>3000){
TEMPERATURA();//ЗАПРАШИВАЕМ ТЕМПЕРАТУРУ
Show_Menu_STANDBY();//ПЕЧАТАЕМ ТЕМПЕРАТУРУ
LED_Brightness();//ПРОВЕРЯЕМ ОСВЕЩЁННОСТЬ И УСТАНАВЛИВАЕМ ЯРКОСТЬ ЭКРАНА
Timer_MENU=millis();}//ОБНУЛЯЕМ ТАЙМЕР
}
/////////////////////////////////////////////////////////////////////////////////////////////////



/////////////////////////////////////////////////////////////////////////////////////////////////
//                                      DELAY PROTECTION ON                                    //
/////////////////////////////////////////////////////////////////////////////////////////////////
if(SET_Protection==true){


/////////////////////////////////////////////////////////////////////////////////////////////////
//                               МЕНЮ ОБРАТНОГО ОТСЧЁТА ДО ВКЛЮЧЕНИЯ                           //
//                                      DELAY PROTECTION ON                                    //
/////////////////////////////////////////////////////////////////////////////////////////////////

//ВЫВОДИМ ИНФОРМАЦИЮ ОБ ОСТАВШЕМСЯ ВРЕМЕНИ ПАУЗЫ НА ЭКРАН, А ПО ЗАВЕРШЕНИЮ ВКЛЮЧАЕМ ВЫХОД
if(FL_PROTECTION_menu==true){
if(millis()-Timer_MENU>=1000){
Secunds=Secunds-1;//КАЖДУЮ СЕКУНДУ УМЕНЬШАЕМ КОЛЛИЧЕСТВО СЕКУНД ДО ПЕРЕХОДА В "PROTECTION ON"
if(Secunds==0){//ЕСЛИ ПАУЗА ЗАКОНЧИЛАСЬ
digitalWrite(HEAT_RELAY_OUT_PIN,LOW);//ВКЛЮЧАЕМ РЕЛЕ И ИНДИКАТОР "HEAT"
LC.clearDisplay(0);//ЧИСТИМ ЭКРАН
FL_PROTECTION_menu=false;FL_STANDBY_menu=true;
Timer_MENU=millis()-3000;//ДЛЯ МГНОВЕННОГО ПОКАЗА ТЕМПЕРАТУРЫ
  }else{//ЕСЛИ СЕКУНДЫ ЕЩЁ ОСТАЛИСЬ
Show_Menu_TERMOSTAT_PAUSE();//ПЕЧАТАЕМ ТЕМПЕРАТУРУ
LED_Brightness();//ПРОВЕРЯЕМ ОСВЕЩЁННОСТЬ И УСТАНАВЛИВАЕМ ЯРКОСТЬ ЭКРАНА
Timer_MENU=millis();}}
}
/////////////////////////////////////////////////////////////////////////////////////////////////

}//END DELAY PROTECTION MENU
/////////////////////////////////////////////////////////////////////////////////////////////////





/////////////////////////////////////////////////////////////////////////////////////////////////
//                          МЕНЮ УСТАНОВКИ ИНТЕРВАЛА ПЕРЕД ВКЛЮЧЕНИЕМ                          //
//                                  SET DELAY PROTECTION MENU                                  //
/////////////////////////////////////////////////////////////////////////////////////////////////
if(SET_DELAY_PROTECTION_menu==true){


/////////////////////////////////////////////////////////////////////////////////////////////////
//БЛОК ОБРАБОТКИ КНОПОК
//КНОПКА "+" 
if(FL_STEP_UP_Batton_PRESS==true){
++Vol;Show_Menu_SET_DELAY_PROTECTION();Return=Wait_AutoRet;FL_delay_REPEAT=true;
Timer_REPEAT=millis();Timer_MENU=millis();
   FL_STEP_UP_Batton_PRESS=false;}
if(FL_delay_REPEAT==true&&STEP_UP_btn==LOW&&millis()-Timer_BTN>500){
if(millis()>Timer_REPEAT){Timer_REPEAT=millis()+110;
++Vol;Show_Menu_SET_DELAY_PROTECTION();Timer_MENU=millis();}
}
//КНОПКА "-"
if(FL_STEP_DN_Batton_PRESS==true){
--Vol;Show_Menu_SET_DELAY_PROTECTION();Return=Wait_AutoRet;FL_delay_REPEAT=true;
Timer_REPEAT=millis();Timer_MENU=millis();
   FL_STEP_DN_Batton_PRESS=false;}
if(FL_delay_REPEAT==true&&STEP_DN_btn==LOW&&millis()-Timer_BTN>500){
if(millis()>Timer_REPEAT){Timer_REPEAT=millis()+110;
--Vol;Show_Menu_SET_DELAY_PROTECTION();Timer_MENU=millis();}
}
/////////////////////////////////////////////////////////////////////////////////////////////////





//ПЕЧАТАЕМ ДЛИТЕЛЬНОСТЬ ПАУЗЫ, И ОТСЧЁТ ВРЕМЕНИ ДО ВЫХОДА ИЗ МЕНЮ 
if(millis()-Timer_MENU>=1000){
Return=Return-1;//КАЖДУЮ СЕКУНДУ УМЕНЬШАЕМ КОЛЛИЧЕСТВО СЕКУНД ДО АВТОВЫХОДА
if(Return==0){//ЕСЛИ ВРЕМЯ ДЕМОНСТРАЦИИ МЕНЮ ЗАКОНЧИЛОСЬ
EEPROM_UPDATE();//СОХРАНЯЕМ ПЕРЕМЕННЫЕ В ПАМЯТЬ
LC.clearDisplay(0);//ЧИСТИМ ЭКРАН
SET_DELAY_PROTECTION_menu=false;//ЗАПРЕЩАЕМ РАБОТУ ТЕКУЩЕГО МЕНЮ
FL_STANDBY_menu=true;//РАЗРЕШАЕМ ДЕМОНСТРАЦИЮ ТЕКУЩЕЙ ТЕМПЕРАТУРЫ
Timer_MENU=millis()-3000;//ДЛЯ МГНОВЕННОГО ПОКАЗА ТЕМПЕРАТУРЫ
  }else{//ЕСЛИ СЕКУНДЫ ЕЩЁ ОСТАЛИСЬ
Show_Menu_SET_DELAY_PROTECTION();//ПЕЧАТАЕМ МЕНЮ НАСТРОЙКИ ПАУЗЫ
LED_Brightness();//ПРОВЕРЯЕМ ОСВЕЩЁННОСТЬ И УСТАНАВЛИВАЕМ ЯРКОСТЬ ЭКРАНА
Timer_MENU=millis();}
}

}//END SET DELAY PROTECTION MENU
/////////////////////////////////////////////////////////////////////////////////////////////////


}//END LOOP
/////////////////////////////////////////////////////////////////////////////////////////////////


/////////////////////////////////////////////////////////////////////////////////////////////////
//                                            END                                              //
/////////////////////////////////////////////////////////////////////////////////////////////////
